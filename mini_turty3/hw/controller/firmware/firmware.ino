#include "U8glib.h"

#define PIN_D0   4
#define PIN_D1   12
#define PIN_RES  9
#define PIN_DC   8
#define PIN_CS   6
#define PIN_BAT  A5

U8GLIB_SSD1306_128X64 u8g(PIN_D0, PIN_D1, PIN_RES, PIN_DC, PIN_CS);
// U8G2_SSD1309_128X64_NONAME0_1_4W_SW_SPI u8g(PIN_D0, PIN_D1, PIN_RES, PIN_DC, PIN_CS);  // SW SPI Com: SCK = 4, MOSI = 5, CS = 6, A0 = 7 (new white HalTec OLED)
// U8GLIB_SSD1306_128X64 u8g(0);
// U8G2_SSD1306_128X64_NONAME_2_SW_I2C u8g(U8G2_R0, PIN_D0, PIN_D1);

char out[6];  // текстовый массив
long ms = 0;
long ms1 = 0;
bool bArm = true;

#define fablab_width 64
#define fablab_height 59
const static unsigned char fablab_bits[] U8G_PROGMEM = {
   0xff, 0xff, 0xff, 0xff, 0xff, 0xff, 0xff, 0xff, 0xff, 0xff, 0xff, 0xff,
   0xff, 0xff, 0xff, 0xff, 0xff, 0xff, 0xff, 0xff, 0xff, 0xff, 0xff, 0xff,
   0xf7, 0xff, 0xff, 0xff, 0xff, 0xff, 0xff, 0xff, 0xc7, 0xff, 0xff, 0xff,
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   0xff, 0xff, 0xff, 0xff };
   
void drawLogo(uint8_t d)
{
    /*u8g.setFont(u8g_font_gdr25r);
    u8g.drawStr(0+d, 30+d, "U");
    u8g.setFont(u8g_font_gdr30n);
    u8g.drawStr90(23+d,10+d,"8");
    u8g.setFont(u8g_font_gdr25r);
    u8g.drawStr(53+d,30+d,"g");
    
    u8g.drawHLine(2+d, 35+d, 47);
    u8g.drawVLine(45+d, 32+d, 12);*/
    //u8g.drawBox(g*w + b*w*8, r*h, w, h);
}

void drawURL(void)
{
  u8g.setFont(u8g_font_profont12);
  u8g.drawStr(1,54,"     fabbot-mate");
  u8g.drawStr(1,64,"   robot offline ;(");
  u8g.drawHLine(1, 43, 127);
}

void drawStatus(bool armed) {
  for (int i=0; i<7; i++) {out[i]=' ';}  // заполнение пробелами 
  // Battery
  int rawBat = analogRead(PIN_BAT);
  int bat = rawBat / 3 * 2;
  u8g.drawVLine(80, 0, 18);
  u8g.drawHLine(80, 17, 48);
  u8g.setColorIndex(0);
  u8g.drawBox(81, 0, 48, 16);
  u8g.setColorIndex(1);
  u8g.setFont(u8g_font_helvB14);
  itoa(bat, out, 10);
  int lastChar = strlen(out);
  out[lastChar + 2] = out[lastChar];
  out[lastChar] = out[lastChar - 1];
  out[lastChar - 1] = '.';
  out[lastChar + 1] = 'v';
  u8g.drawStr(82, 16, out);
  //Serial.print(out);
  //Serial.println();

  if (armed) {
    u8g.setColorIndex(1);
    u8g.drawBox(0, 0, 46, 18);
    u8g.setColorIndex(0);
    u8g.drawStr(1,16, "ARM");
    u8g.setColorIndex(1);
  } else {
    u8g.setColorIndex(0);
    u8g.drawBox(0, 0, 46, 18);
    u8g.setColorIndex(1);
    u8g.drawStr(1,16, "SAFE");
  }
}

void draw(void) {
  if (millis() < 3000) {
    u8g.drawXBMP(32, 0, fablab_width, fablab_height, fablab_bits);
  } else {
    u8g.setColorIndex(1);
    drawLogo(0);
    drawStatus(bArm);
    drawURL();
  }
}

void setup(void) {
  //u8g.setRot180();   // flip screen, if required
  Serial.begin(115200);
}

void loop(void) {
  // picture loop
  if (millis() > ms1 + 500) {
    ms1 = millis();
    // rebuild the picture after some delay
    u8g.firstPage();  
    do {
      draw();
      u8g.setColorIndex(1);
    } while( u8g.nextPage() );
  }
 

  if (millis() > ms + 2000) {
    ms = millis();
    bArm = !bArm;
  }
}
